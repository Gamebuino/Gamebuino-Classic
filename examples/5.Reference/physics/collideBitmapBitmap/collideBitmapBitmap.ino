#include <SPI.h>
#include <Gamebuino.h>
Gamebuino gb;

//find the bitmap encoder at https://github.com/Rodot/BitmapEncoder
const byte oponentBitmap[] PROGMEM = {88,48,0x0,0x1F,0xFF,0xFF,0xFF,0xFF,0xFF,0xFF,0xFF,0xFF,0xF0,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0xFF,0xF0};
const byte playerBitmap[] PROGMEM = {8,8,0x7E,0xE3,0xF1,0xE1,0xFF,0x34,0xFF,0xA5};

int player_x = LCDWIDTH/2;
int player_y = LCDHEIGHT/2;

int oponent_x = 0;
int oponent_y = 6;

void setup(){
  gb.begin();
  gb.titleScreen(F("collideBitmapBitmap"));
}

void loop(){
  if(gb.update()){
    gb.display.println(F("Move with arrows"));

    if(gb.buttons.pressed(BTN_C)){
      gb.titleScreen(F("collideBitmapBitmap"));
    }

    //update player
    if(gb.buttons.repeat(BTN_RIGHT,1)){
      player_x = player_x + 1;
    }
    if(gb.buttons.repeat(BTN_LEFT,1)){
      player_x = player_x - 1;
    }
    if(gb.buttons.repeat(BTN_DOWN,1)){
      player_y = player_y + 1;
    }
    if(gb.buttons.repeat(BTN_UP,1)){
      player_y = player_y - 1;
    }

    //update collisions
    if(gb.collideBitmapBitmap(player_x, player_y, playerBitmap, oponent_x, oponent_y, oponentBitmap)){
      gb.sound.playTick();
      gb.display.print(F("Colliding"));
    }

    //draw bitmaps
    gb.display.setColor(INVERT);
    gb.display.drawBitmap(player_x, player_y, playerBitmap);
    gb.display.drawBitmap(oponent_x, oponent_y, oponentBitmap);
    gb.display.setColor(BLACK);
  }
}


