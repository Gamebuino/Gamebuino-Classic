#include <SPI.h>
#include <EEPROM.h>
#include <Gamebuino.h>

Gamebuino gb;

// Configuration

// playground (field) dimensions
#define SCREEN_TILES_H                       16
#define SCREEN_TILES_V                       9
#define SOKOBAN_FIELD_WIDTH                  (SCREEN_TILES_H)
#define SOKOBAN_FIELD_HEIGHT                 (SCREEN_TILES_V)
#define SOKOBAN_FIELD_LEFT                   (0)
#define SOKOBAN_FIELD_TOP                    (0)
#define SOKOBAN_FIELD_RIGHT                  (SOKOBAN_FIELD_LEFT + SCREEN_TILES_H - 1)
#define SOKOBAN_FIELD_BOTTOM                 (SOKOBAN_FIELD_TOP + SCREEN_TILES_V - 1)
#define SOKOBAN_OFFSET_UP                    (0 - (SCREEN_TILES_H))
#define SOKOBAN_OFFSET_DOWN                  (SCREEN_TILES_H)
#define SOKOBAN_OFFSET_LEFT                  (-1)
#define SOKOBAN_OFFSET_RIGHT                 (1)

#define SOKOBAN_UNDO_RINGBUFFER_SIZE         (256)  // Size of the undo ringbuffer (count of moves) - must be tuned to fit into RAM

// Sokoban sounds
#define SOKOBAN_SOUND_MOVE                   (0)
#define SOKOBAN_SOUND_PUSH                   (1)
#define SOKOBAN_SOUND_CANT_MOVE              (2)
#define SOKOBAN_SOUND_CONGRAT                (3)
#define SOKOBAN_SOUND_KEY                    (4)

// Sokoban tiles (font)
#define FONT_SOKOBAN_FLOOR                   0
#define FONT_SOKOBAN_TARGET                  1
#define FONT_SOKOBAN_BLOCK                   2
#define FONT_SOKOBAN_BLOCK_TARGET            3
#define FONT_SOKOBAN_SKY                     4
#define FONT_SOKOBAN_WALL                    5
#define FONT_SOKOBAN_PLAYER                  6
#define FONT_SOKOBAN_PLAYER_TARGET           7
#define FONT_SOKOBAN_0                       8

const uint8_t sokoban_tiles[][7] PROGMEM = {
  {5,5, 0x00,0x00,0x00,0x00,0x00},
  {5,5, 0x00,0x00,0x20,0x00,0x00},
  {5,5, 0xF8,0x88,0x88,0x88,0xF8},
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  {5,5, 0x70,0x88,0xA8,0x88,0x70},
};

#define GUI_STATE_INTRO                    (0)
#define GUI_STATE_GAME                     (1)
#define GUI_STATE_LEVELS                   (2)
#define GUI_STATE_CONGRATS                 (3)
uint8_t current_gui_state = GUI_STATE_INTRO;

int8_t level_select_pos = 0;

// Sokoban Levels
#define SOKOBAN_LEVELS_COUNT (600) // number of levels in data lower

// Compressed level data
// levels are parts of:
//  - Microban, Sasquatch (by David W. Skinner - http://users.bentonrea.com/~sasquatch/sokoban/)
//  - Procedurally generated levels (by Joshua Taylor and Ian Parberry - http://larc.unt.edu/ian/research/sokoban/)

/*
 * Compression algorithm:
 * Stream is divided into nibbles (4-bit wide numbers).
 * First nibble defines width of level data (1-16) (width is value+1)
 * Second nibble defines height of level data (1-9) (height is value+1)
 * Next nibbles are level data:
 *   - if leftmost bit is 0, next 3 bits defines type of tile to write on screen:
 *     - 000 = floor
 *     - 001 = target
 *     - 010 = box
 *     - 011 = box on target
 *     - 100 = sky (empty = area outside walls - whole game area is at first set to this tile)
 *     - 101 = wall
 *     - 110 = sokoban (player)
 *     - 111 = sokoban on target
 *   - if leftmost bit is 1, next 3 bits defines type of tile, which is written double (two times), except for:
 *     - (1)110 = "enter" - jump to the leftmost position on next line (it is not necessary to use enter, because we know width of level, so it may overlap for better compression)
 *     - (1)111 = "end of level" - marks end of level (if it's on first nibble, second nibble should be 1111 too - to round level data to whole byte; end of level must be specified - isn't implied from width and height)
 *
 * Level is written into viewport of given width and height, which is centered in game area.
 *
 * Example: 0x42,0xdd,0xd6,0x21,0xdd,0xdf
 *   - 0x42: width of level is 4+1=5; height of level is 2+1=3
 *   - tiles are:
 *     - 0xdd: wall, wall; wall, wall
 *     - 0xd6: wall, (implicit new line), wall; sokoban
 *     - 0x21: box; target
 *     - 0xdd: wall, (implicit new line), wall; wall, wall
 *     - 0xdf: wall, wall; (end of level)
 *   - so level is:
 *     #####
 *     #@$.#
 *     #####
 */
const uint8_t sokoban_levels[] PROGMEM = {
0x56,0xdd,0xe5,0x01,0x5e,0x58,0xdd,0x36,0x8d,0x82,0x0d,0x8d,0xdd,0x5f,
0x56,0xdd,0xd5,0x88,0xd0,0x56,0x0d,0x02,0x30,0xd0,0x13,0x0d,0x88,0xdd,0xd5,0xff,
0x85,0xcd,0xde,0xd5,0x8d,0xd5,0x88,0x02,0x0d,0x05,0x85,0x20,0xd0,0x10,0x15,0x60,0xdd,0xdd,0xdf,
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0x66,0xcd,0xd5,0xc5,0x81,0x5c,0x58,0x1d,0xd2,0x0d,0x56,0x0a,0x5e,0x51,0x80,0x5e,0xdd,0xdf,
};



// Game variables
uint16_t sokoban_level; // index of current level
uint8_t sokoban_level_done; // info, if current level has been done

char* sokoban_level_data_pointer; // pointer to start of this level in program memory
char* sokoban_level_data_pointer_next; // pointer to start of next level in program memory

uint16_t sokoban_moves; // number of moves that sokoban did (not displayed)
uint16_t sokoban_pushes; // number of pushes that sokoban did (not displayed)
uint16_t sokoban_moves_level; // number of moves that sokoban did since start of level
uint16_t sokoban_pushes_level; // number of pushes that sokoban did since start of level

// undo push ringbuffer
typedef struct { // structure describing one step back in push history
  uint8_t pos; // position where player was before push
  int8_t offset; // offset in vram (level data) where were pushed
} sokoban_undo_ringbuffer_type;
sokoban_undo_ringbuffer_type sokoban_undo_ringbuffer[SOKOBAN_UNDO_RINGBUFFER_SIZE]; // array of structures (ringbuffer)
uint16_t sokoban_undo_ringbuffer_pos; // current position (index) in ringbuffer
uint16_t sokoban_undo_ringbuffer_count; // count of entries in ringbuffer

// Sounds
PROGMEM uint16_t trackPush[] = {0x0015,0x102,0x0000};
PROGMEM uint16_t trackCantMove[] = {0x0015,0x104,0x102,0x0000};
PROGMEM uint16_t trackCongrat[] = {0x0015,0x102,0x104,0x108,0x10A,0x10C,0x10E,0x120,0x130,0x140,0x150,0x0000};

/**
 * Plays sound
 */
void TriggerFx(uint8_t sound_id, uint8_t volume, uint8_t param3) {
  switch (sound_id) {
    case SOKOBAN_SOUND_MOVE:
    case SOKOBAN_SOUND_PUSH:
      // no sound
    break;
    case SOKOBAN_SOUND_KEY:
      gb.sound.playPattern(trackPush, 0);
    break;
    case SOKOBAN_SOUND_CANT_MOVE:
      gb.sound.playPattern(trackCantMove, 0);
    break;
    case SOKOBAN_SOUND_CONGRAT:
      gb.sound.playPattern(trackCongrat, 0);
    break;
  }
}

// emulating TVText functions
uint8_t text_pos_x1, text_pos_y1, text_pos_x2, text_pos_y2, text_pos_x, text_pos_y; // text positioning (window parameters and cursor position)
uint8_t vram[SCREEN_TILES_H * SCREEN_TILES_V];

/**
 * Draws emulated TVText's screen on Gamebuino's
 */
void text_draw_screen() {
  gb.display.clear();
  for (uint8_t x = 0; x < SCREEN_TILES_H; x++) {
    for (uint8_t y = 0; y < SCREEN_TILES_V; y++) {
      gb.display.drawBitmap(x*5, y*5, sokoban_tiles[vram[x + y * SCREEN_TILES_H]]);
    }
  }
}

/**
 * Sets window position
 * @param uint8_t x1 left margin of window
 * @param uint8_t y1 top margin of window
 * @param uint8_t x2 right margin of window
 * @param uint8_t y2 bottom margin of window
 */
void text_set_window(uint8_t x1, uint8_t y1, uint8_t x2, uint8_t y2) {
  text_pos_x1 = x1;
  text_pos_y1 = y1;
  text_pos_x2 = x2;
  text_pos_y2 = y2;
  text_pos_x = x1;
  text_pos_y = y1;
}

/**
 * Puts a character into vram (screen)
 * @param uint8_t c character to print
 */
void text_putc(uint8_t c) {
  vram[text_pos_x + text_pos_y * SCREEN_TILES_H] = c;
  text_pos_x++;
  if (text_pos_x > text_pos_x2) {
    text_pos_x = text_pos_x1;
    text_pos_y++;
    if (text_pos_y > text_pos_y2) {
      text_pos_y = text_pos_y1;
    }
  }
}

/**
 * Advances text cursor to beginning of next line. At the bottom wraps to the top.
 */
void text_next_line() {
  text_pos_x = text_pos_x1;
  text_pos_y++;
  if (text_pos_y > text_pos_y2) {
    text_pos_y = text_pos_y1;
  }
}

/**
 * Writes information into EEPROM, that given level has been done.
 * @param uint16_t level index of level to mark as done
 */
void eeprom_set_level_done(uint16_t level) {
  uint8_t byte_id = 3 + (level / 8);
  uint8_t bit_id = level % 8;

  uint8_t value = EEPROM.read(byte_id);
  value |= (1 << bit_id);
  EEPROM.write(byte_id, value);
}

/**
 * Reads from EEPROM if given level has been done.
 * @param uint16_t level index of level, which we want to know, if has been done
 * @return int8_t true if level has been done, otherwise false
 */
uint8_t eeprom_is_level_done(uint16_t level) {
  uint8_t byte_id = 3 + (level / 8);
  uint8_t bit_id = level % 8;
  if (EEPROM.read(byte_id) & (1 << bit_id)) {
    return 1;
  }
  return 0;
}

/**
 * Saves into EEPROM last played level.
 * @param uint16_t level index of level to save
 */
void eeprom_set_last_level(uint16_t level) {
  EEPROM.write(1, level & 0xFF);
  EEPROM.write(2, level >> 8);
}

/**
 * Reads from EEPROM last played level
 * @return uint16_t index of level last played
 */
uint16_t eeprom_get_last_level() {
  uint16_t last_level = EEPROM.read(1) | EEPROM.read(2) << 8;
  if (last_level < SOKOBAN_LEVELS_COUNT) {
    return last_level;
  }
  return 0;
}

void eeprom_init() {
  if (EEPROM.read(0) != 51) {
    EEPROM.write(0, 51);
    for (uint8_t i = 1; i < 3 + (SOKOBAN_LEVELS_COUNT / 8 + 1); i++) {
      EEPROM.write(i, 0);
    }
  }
}



/**
 * Loads and draws level data (field and info) on screen
 */
void sokoban_load_level() {
  char* reading_pos; // position of "reading head" in level data (program memory)
  char token, token1, token2; // read token, and his first and second nibble
  uint8_t level_width, level_height; // dimensions of level

  // clear level statistics
  sokoban_moves_level = 0;
  sokoban_pushes_level = 0;

  // clear undo push
  sokoban_undo_ringbuffer_pos = 0;
  sokoban_undo_ringbuffer_count = 0;

  // set position of head to start of level data
  reading_pos = sokoban_level_data_pointer;

  // clear display
  for (uint8_t i = 0; i < 16*12; i++) {
    vram[i] = FONT_SOKOBAN_SKY;
  }

  // read dimensions and set viewport
  token = pgm_read_byte(reading_pos);
  reading_pos++;
  level_width = ((token & 0b11110000) >> 4) + 1;
  level_height = (token & 0b00001111) + 1;

  // centering
  text_set_window(
    (SOKOBAN_FIELD_LEFT + SOKOBAN_FIELD_RIGHT - level_width) / 2 ,
    (SOKOBAN_FIELD_TOP + SOKOBAN_FIELD_BOTTOM - level_height) / 2,
    (SOKOBAN_FIELD_LEFT + SOKOBAN_FIELD_RIGHT - level_width) / 2 + level_width - 1,
    (SOKOBAN_FIELD_TOP + SOKOBAN_FIELD_BOTTOM - level_height) / 2 + level_height - 1
  );

  // read level data and write to screen (compression algorithm is described in sokoban_levels.h)
  do {
    token = pgm_read_byte(reading_pos);
    token1 = ((token & 0b11110000) >> 4);
    token2 = (token & 0b00001111);

    if (token1 < 0xe) {
      text_putc(FONT_SOKOBAN_FLOOR + (token1 & 0b00000111));
      if (token1 > 0x7) {
        text_putc(FONT_SOKOBAN_FLOOR + (token1 & 0b00000111));
      }
    } else {
      text_next_line();
    }
    if (token2 < 0xe) {
      text_putc(FONT_SOKOBAN_FLOOR + (token2 & 0b00000111));
      if (token2 > 0x7) {
        text_putc(FONT_SOKOBAN_FLOOR + (token2 & 0b00000111));
      }
    } else {
      text_next_line();
    }

    reading_pos++;
  } while ((token1 != 0b00001111) && (token2 != 0b00001111));

  // change skies to floors in game area
  for (uint8_t i = text_pos_x1; i <= text_pos_x2; i++) {
    for (uint8_t j = text_pos_y1; j <= text_pos_y2; j++) {
      if (vram[i + j * SCREEN_TILES_H] == FONT_SOKOBAN_SKY) {
        vram[i + j * SCREEN_TILES_H] = FONT_SOKOBAN_FLOOR;
      }
    }
  }

  // get level completion status
  sokoban_level_done = eeprom_is_level_done(sokoban_level);

  // set pointer to next level
  sokoban_level_data_pointer_next = reading_pos;
}

/**
 * Restarts whole game (clears counters and starts at first level)
 */
void sokoban_restart_game() {
  sokoban_level = 0;
  sokoban_level_data_pointer = (char*)sokoban_levels;
  sokoban_moves = 0;
  sokoban_pushes = 0;
  level_select_pos = 0;
}

/**
 * Advances to the next level
 */
void sokoban_advance_level() {
  sokoban_level++;
  sokoban_level_data_pointer = sokoban_level_data_pointer_next;

  if (sokoban_level >= SOKOBAN_LEVELS_COUNT) {
    sokoban_restart_game();
  }
}

/**
 * Skips all levels from the beginning to level before current
 */
void sokoban_skip_to_previous_level() {
  uint16_t to_level;
  if (sokoban_level > 0) {
    to_level = (sokoban_level - 1);
  } else {
    to_level = SOKOBAN_LEVELS_COUNT - 1;
  }
  sokoban_restart_game();
  while (sokoban_level < to_level) {
    sokoban_load_level();
    sokoban_advance_level();
  }
  sokoban_load_level();
}

/**
 * Returns pointer to char with player
 * @return char* pointer on tile in tvtext_buffer, where sokoban is
 */
inline unsigned char* sokoban_find_player() {
  unsigned char* a;

  // iterate through tvtext_buffer and search for sokoban or sokoban on target
  for (a = vram; a < vram + SCREEN_TILES_H * SCREEN_TILES_V; a++) {
    if ((*a == FONT_SOKOBAN_PLAYER) || (*a == FONT_SOKOBAN_PLAYER_TARGET)) {
      return a;
    }
  }

  return NULL;
}

/**
 * Returns if level is cleared
 * @return uint8_t 1 if level is cleared (done), 0 otherwise
 */
inline uint8_t sokoban_is_level_cleared() {
  unsigned char* a;

  // iterate through tvtext buffer and return 0 if block, which is not on target is found
  for (a = vram; a < vram + SCREEN_TILES_H * SCREEN_TILES_V; a++) {
    if (*a == FONT_SOKOBAN_BLOCK) {
      return 0;
    }
  }

  return 1;
}

/**
 * Gives game into state where was before last push
 */
void sokoban_undo_last_push() {
  if (sokoban_undo_ringbuffer_count > 0) { // only if there are entries in ringbuffer
    unsigned char* a; // pointer to tile where sokoban was before push
    unsigned char* b; // pointer to tile where box was before push
    unsigned char* c; // pointer to tile where box is now
    unsigned char* d; // pointer to tile where sokoban is now

    // moving back in ringbuffer
    if (sokoban_undo_ringbuffer_pos > 0) {
      sokoban_undo_ringbuffer_pos--;
    } else {
      sokoban_undo_ringbuffer_pos = SOKOBAN_UNDO_RINGBUFFER_SIZE - 1;
    }
    sokoban_undo_ringbuffer_count--;

    // undoing move in vram (level data)
    a = vram + sokoban_undo_ringbuffer[sokoban_undo_ringbuffer_pos].pos;
    b = a + sokoban_undo_ringbuffer[sokoban_undo_ringbuffer_pos].offset;
    c = b + sokoban_undo_ringbuffer[sokoban_undo_ringbuffer_pos].offset;
    d = sokoban_find_player();

    (*d) -= 6;
    (*a) += 6;
    (*c) -= 2;
    (*b) += 2;

    sokoban_moves_level++;
    sokoban_moves++;
    sokoban_pushes_level--;
    sokoban_pushes--;
  } else {
    // if can't get back in ringbuffer, just restart level
    sokoban_load_level();
  }
}

/**
 * Screen to change level
 */
void sokoban_level_select() {
  gb.display.clear();
  
        gb.display.cursorX = 0;
        gb.display.cursorY = 10;
  gb.display.print(F("Select level:"));
  
        gb.display.cursorX = 60 - (level_select_pos * 4);
        gb.display.cursorY = 6;
  gb.display.write(30);
        gb.display.cursorX = 60 - (level_select_pos * 4);
        gb.display.cursorY = 14;
  gb.display.write(31);

        gb.display.cursorX = 60;
        gb.display.cursorY = 10;
  gb.display.write('0' + (((sokoban_level + 1)) % 10));
        gb.display.cursorX = 60-4;
        gb.display.cursorY = 10;
  gb.display.write('0' + (((sokoban_level + 1) / 10) % 10));
        gb.display.cursorX = 60-8;
        gb.display.cursorY = 10;
  gb.display.write('0' + (((sokoban_level + 1) / 100) % 10));
  
        gb.display.cursorX = 0;
        gb.display.cursorY = 25;
  if (eeprom_is_level_done(sokoban_level)) {
    gb.display.print(F("Finished"));
  } else {
    gb.display.print(F("Not finished"));
  }

  if (gb.buttons.repeat(BTN_LEFT, 5)) {
    level_select_pos++;
    TriggerFx(SOKOBAN_SOUND_KEY, 0xff, false);
    if (level_select_pos > 2) {
      level_select_pos = 2;
      TriggerFx(SOKOBAN_SOUND_CANT_MOVE, 0xff, false);
    }
  }
  
  if (gb.buttons.repeat(BTN_RIGHT, 5)) {
    level_select_pos--;
    TriggerFx(SOKOBAN_SOUND_KEY, 0xff, false);
    if (level_select_pos < 0) {
      level_select_pos = 0;
      TriggerFx(SOKOBAN_SOUND_CANT_MOVE, 0xff, false);
    }
  }
  
  if (gb.buttons.repeat(BTN_DOWN, 5)) {
    switch (level_select_pos) {
      case 0:
        if (sokoban_level >= 1) {
          sokoban_level--;
          TriggerFx(SOKOBAN_SOUND_KEY, 0xff, false);
        } else {
          sokoban_level = 0;
          TriggerFx(SOKOBAN_SOUND_CANT_MOVE, 0xff, false);
        }
        break;
      case 1:
        if (sokoban_level >= 10) {
          sokoban_level -= 10;
          TriggerFx(SOKOBAN_SOUND_KEY, 0xff, false);
        } else {
          sokoban_level = 0;
          TriggerFx(SOKOBAN_SOUND_CANT_MOVE, 0xff, false);
        }
        break;
      case 2:
        if (sokoban_level >= 100) {
          sokoban_level -= 100;
          TriggerFx(SOKOBAN_SOUND_KEY, 0xff, false);
        } else {
          sokoban_level = 0;
          TriggerFx(SOKOBAN_SOUND_CANT_MOVE, 0xff, false);
        }
        break;
    }
  }
  
  if (gb.buttons.repeat(BTN_UP, 5)) {
    switch (level_select_pos) {
      case 0:
        sokoban_level++;
        TriggerFx(SOKOBAN_SOUND_KEY, 0xff, false);
        break;
      case 1:
        sokoban_level += 10;
        TriggerFx(SOKOBAN_SOUND_KEY, 0xff, false);
        break;
      case 2:
        sokoban_level += 100;
        TriggerFx(SOKOBAN_SOUND_KEY, 0xff, false);
        break;
    }
    if (sokoban_level >= SOKOBAN_LEVELS_COUNT) {
      sokoban_level = SOKOBAN_LEVELS_COUNT - 1;
      TriggerFx(SOKOBAN_SOUND_CANT_MOVE, 0xff, false);
    }
  }
  
  if (gb.buttons.pressed(BTN_A) || gb.buttons.pressed(BTN_B)) {
    TriggerFx(SOKOBAN_SOUND_KEY, 0xff, false);
    // load that level
    uint16_t level_to_load = sokoban_level;
    sokoban_restart_game();
    for (uint16_t i = 0; i < level_to_load; i++) {
      sokoban_load_level();
      sokoban_advance_level();
    }
    sokoban_load_level();
    eeprom_set_last_level(sokoban_level);
    
    current_gui_state = GUI_STATE_GAME;
  }
}

/**
 * Process sokoban's move
 */
inline void sokoban_move() {
  unsigned char* a; // pointer to tile that sokoban stands on
  unsigned char* b; // pointer to tile where sokoban goes to
  unsigned char* c; // pointer to tile where sokoban pushes box
  int8_t offset;// pointer offset to next tile (direction of sokoban's move)

  // get offset according to sokoban's direction
  if (gb.buttons.pressed(BTN_LEFT)) {
    offset = SOKOBAN_OFFSET_LEFT;
  }
  if (gb.buttons.pressed(BTN_RIGHT)) {
    offset = SOKOBAN_OFFSET_RIGHT;
  }
  if (gb.buttons.pressed(BTN_UP)) {
    offset = SOKOBAN_OFFSET_UP;
  }
  if (gb.buttons.pressed(BTN_DOWN)) {
    offset = SOKOBAN_OFFSET_DOWN;
  }

  // button A undoes last push
  if (gb.buttons.pressed(BTN_A)) {
    if (sokoban_moves_level == 0) {
      TriggerFx(SOKOBAN_SOUND_CANT_MOVE, 0xff, false);
    } else {
      TriggerFx(SOKOBAN_SOUND_KEY, 0xff, false);
    }
    sokoban_undo_last_push();
  }

  // button B restarts level
  if (gb.buttons.pressed(BTN_B)) {
    if (sokoban_moves_level == 0) {
      TriggerFx(SOKOBAN_SOUND_CANT_MOVE, 0xff, false);
    } else {
      TriggerFx(SOKOBAN_SOUND_KEY, 0xff, false);
    }
    sokoban_load_level();
  }

  // button C shows level selection screen
  if (gb.buttons.pressed(BTN_C)) {
    current_gui_state = GUI_STATE_LEVELS;
  }

  // return if no move should be processed
  if (!gb.buttons.pressed(BTN_LEFT) && !gb.buttons.pressed(BTN_RIGHT) && !gb.buttons.pressed(BTN_UP) && !gb.buttons.pressed(BTN_DOWN)) {
    return;
  }

  // search for sokoban and next 2 tiles in his way
  a = sokoban_find_player();
  b = a + offset;
  c = b + offset;

  // if sokoban can move that way...
  if (
    ((*b >= FONT_SOKOBAN_FLOOR) && (*c >= FONT_SOKOBAN_FLOOR))
    &&
      (
        (*b <= FONT_SOKOBAN_TARGET)
        ||
        ((*b <= FONT_SOKOBAN_BLOCK_TARGET) && (*c <= FONT_SOKOBAN_TARGET))
      )
    ) {
    // ... move him ...
    sokoban_moves++;
    sokoban_moves_level++;
    (*a) -= 6;
    // ... and if must push the block ...
    if (*b >= FONT_SOKOBAN_BLOCK) {
      TriggerFx(SOKOBAN_SOUND_PUSH, 0xff, false);

      // ... record for undo ...
      sokoban_undo_ringbuffer[sokoban_undo_ringbuffer_pos].pos = a - vram;
      sokoban_undo_ringbuffer[sokoban_undo_ringbuffer_pos].offset = offset;
      if (sokoban_undo_ringbuffer_count < SOKOBAN_UNDO_RINGBUFFER_SIZE) {
        sokoban_undo_ringbuffer_count++;
      }
      sokoban_undo_ringbuffer_pos = (sokoban_undo_ringbuffer_pos + 1) % SOKOBAN_UNDO_RINGBUFFER_SIZE;

      // ... and push it
      sokoban_pushes++;
      sokoban_pushes_level++;
      (*b) -= 2;
      (*c) += 2;
    } else {
      TriggerFx(SOKOBAN_SOUND_MOVE, 0xff, false);
    }
    (*b) += 6;
  } else {
    TriggerFx(SOKOBAN_SOUND_CANT_MOVE, 0xff, false);
  }
}

/**
 * Print number formatted in base of 10 (with leading zeroes - fixed length)
 * @param uint8_t x X coordinate of text
 * @param uint8_t y Y coordinate of text
 * @param uint16_t number number to print
 * @param uint8_t digits number of digits to print
 */
void text_print_number(uint8_t x, uint8_t y, uint16_t number, uint8_t digits) {
  for (uint8_t i = digits; i > 0; i--) {
    uint16_t mul = 1;
    for (uint8_t j = 1; j < i; j++) {
      mul *= 10;
    }
    gb.display.cursorX = x + 4 * (digits - i);
    gb.display.cursorY = y;
    gb.display.write('0' + ((number / mul) % 10));
  }
}

void show_intro() {
  gb.display.clear();
  gb.display.cursorX = 0;
  gb.display.cursorY = 0;
  gb.display.print(F("Sokobuino"));
  gb.display.drawFastHLine(0, 5, 84);
  gb.display.cursorX = 0;
  gb.display.cursorY = 7;
  gb.display.println(F("Programming:"));
  gb.display.cursorX = 10;
  gb.display.cursorY++; //add some extra vertical spacing
  gb.display.println(F("Martin Sustek"));
  gb.display.cursorY++;
  gb.display.println(F("Level design:"));
  gb.display.cursorX = 10;
  gb.display.cursorY++;
  gb.display.println(F("David W. Skinner"));
  gb.display.cursorX = 10;
  gb.display.cursorY++;
  gb.display.println(F("Joshua Taylor"));
  gb.display.cursorX = 10;
  gb.display.cursorY++;
  gb.display.println(F("Ian Parberry"));
  
  if (gb.buttons.pressed(BTN_A) || gb.buttons.pressed(BTN_B)) {
    current_gui_state = GUI_STATE_GAME;
  }
}


void sokoban_show_congratulations() {
  gb.display.clear();
  
  gb.display.cursorX = 5;
  gb.display.cursorY = 10;
  gb.display.print(F("Congratulations!"));
  gb.display.drawFastHLine(0, 18, 84);
  gb.display.cursorX = 0;
  gb.display.cursorY = 20;
  gb.display.print(F("You've finished level"));
  gb.display.cursorX = 0;
  gb.display.cursorY = 27;
  gb.display.print(F("    by        moves"));
  gb.display.cursorX = 0;
  gb.display.cursorY = 34;
  gb.display.print(F("and       pushes."));
  
  text_print_number(0 * 4, 27, sokoban_level + 1, 3);
  text_print_number(7 * 4, 27, sokoban_moves_level, 6);
  text_print_number(4 * 4, 34, sokoban_pushes_level, 5);
  
  
  if (gb.buttons.pressed(BTN_A) || gb.buttons.pressed(BTN_B)) {
    current_gui_state = GUI_STATE_GAME;
    
    sokoban_advance_level();
    sokoban_load_level();
    eeprom_set_last_level(sokoban_level);
  }
}

void sokoban_congratulations() {
  TriggerFx(SOKOBAN_SOUND_CONGRAT, 0xff, false);
  
  current_gui_state = GUI_STATE_CONGRATS;
}


// the setup routine runs once when Gamebuino starts up
void setup() {
  // initialize the Gamebuino object
  gb.begin();
  gb.titleScreen(F("Sokobuino"));
  
  // start new game
  eeprom_init();
  sokoban_restart_game();

  // load that level
  uint16_t last_level = eeprom_get_last_level();
  for (uint16_t i = 0; i < last_level; i++) {
    sokoban_load_level();
    sokoban_advance_level();
  }
  sokoban_load_level();
}

int free_ram() {
  extern int __heap_start, *__brkval; 
  int v; 
  return (int) &v - (__brkval == 0 ? (int) &__heap_start : (int) __brkval); 
}

void display_free_ram() {
  text_print_number(0, 42, free_ram(), 4);
}


// the loop routine runs over and over again forever
void loop() {
  //updates the gamebuino (the display, the sound, the auto backlight... everything)
  //returns true when it's time to render a new frame (20 times/second)
  if (gb.update()) {
    if (current_gui_state == GUI_STATE_INTRO) {
      show_intro();
    } else if (current_gui_state == GUI_STATE_GAME) {
      sokoban_move();
      text_draw_screen();
      //display_free_ram();
      
      // if this move finishes level, skip to next level
      if (sokoban_is_level_cleared()) {
        sokoban_level_done = 1;
        eeprom_set_level_done(sokoban_level);
  
        sokoban_congratulations();
      }
      
    } else if (current_gui_state == GUI_STATE_LEVELS) {
      sokoban_level_select();
    } else if (current_gui_state == GUI_STATE_CONGRATS) {
      sokoban_show_congratulations();
    }
  }
}

